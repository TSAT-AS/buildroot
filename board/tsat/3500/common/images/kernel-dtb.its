## board/tsat/3500/common/images/kernel-dtb.its
```
/*
 * TSAT3500: FIT image with kernel and device tree in a signed configuration
 */

/dts-v1/;

/ {
	description = "TSAT3500 image";
	#address-cells = <1>;

	images {
		kernel-1 {
			description = "default kernel";
			data = /incbin/("./zImage");
			type = "kernel";
			arch = "arm";
			os = "linux";
			compression = "none";
			load = <0x8000>;
			entry = <0x8000>;
			hash-1 {
				algo = "sha1";
			};
		};
		fdt-1 {
			description = "default device tree";
			data = /incbin/("./linux.dtb");
			type = "flat_dt";
			arch = "arm";
			compression = "none";
			hash-1 {
				algo = "sha1";
			};
		};
	};

	configurations {
		default = "conf-1";
		conf-1 {
			description = "default configuration";
			kernel = "kernel-1";
			fdt = "fdt-1";
			signature-1 {
				algo = "sha1,rsa2048";
				key-name-hint = "dev";
				sign-images = "fdt", "kernel";
			};
		};
	};
};
```

## board/tsat/3500/common/images/u-boot-script.its
```
/*
 * TSAT3500: FIT with boot script
 */

/dts-v1/;

/ {
	description = "TSAT3500 boot script";

	images {
		script-1 {
			description = "default bootscript";
			data = /incbin/("./boot_script.txt");
			type = "script";
			compression = "none";
			hash-1 {
				algo = "sha1";
			};
		};
	};
};
```

## configs/enclustra_xilinx_supertiny_defconfig
```kconfig
BR2_arm=y
BR2_cortex_a9=y
BR2_ARM_EABIHF=y
BR2_ARM_ENABLE_NEON=y
BR2_ARM_FPU_NEON=y
BR2_BACKUP_SITE="http://www.enclustra.com/binaries/enclustra-bsp/busybox-rootfs"
BR2_KERNEL_HEADERS_4_4=y
BR2_TOOLCHAIN_BUILDROOT_WCHAR=y
BR2_TARGET_GENERIC_ROOT_PASSWD="root"
BR2_TARGET_GENERIC_GETTY_PORT="ttyPS0"
BR2_ROOTFS_POST_BUILD_SCRIPT="board/enclustra/ebe_overlays.sh"
BR2_USE_MMU=y
BR2_TOOLCHAIN_HAS_THREADS=y
BR2_PACKAGE_BUSYBOX_SHOW_OTHERS=y
BR2_PACKAGE_E2TOOLS=y
BR2_PACKAGE_MTD=y
BR2_PACKAGE_OPENSSH=y
BR2_TARGET_ROOTFS_CPIO=y
BR2_TARGET_ROOTFS_CPIO_GZIP=y
BR2_TARGET_ROOTFS_CPIO_UIMAGE=y
BR2_PACKAGE_SWUPDATE=y
BR2_PACKAGE_SWUPDATE_CONFIG="package/swupdate/swupdate.config"
```

## configs/tsat_3500_mmc_defconfig
```kconfig
BR2_arm=y
BR2_cortex_a9=y
BR2_ARM_ENABLE_NEON=y
BR2_ARM_ENABLE_VFP=y
BR2_GLOBAL_PATCH_DIR="board/tsat/3500/common/patches"
BR2_TOOLCHAIN_EXTERNAL=y
BR2_TOOLCHAIN_EXTERNAL_GDB_SERVER_COPY=y
BR2_TARGET_GENERIC_HOSTNAME="tsat3500"
BR2_TARGET_GENERIC_ISSUE="Welcome to TSAT3500"
BR2_TARGET_GENERIC_ROOT_PASSWD="123"
BR2_TARGET_GENERIC_GETTY_PORT="ttyPS0"
# BR2_TARGET_GENERIC_REMOUNT_ROOTFS_RW is not set
BR2_ROOTFS_OVERLAY="board/tsat/3500/common/rootfs_overlay board/tsat/3500/mmc/rootfs_overlay"
BR2_ROOTFS_POST_IMAGE_SCRIPT="board/tsat/3500/common/post_image.sh board/tsat/3500/mmc/post_image.sh"
BR2_LINUX_KERNEL=y
BR2_LINUX_KERNEL_CUSTOM_GIT=y
BR2_LINUX_KERNEL_CUSTOM_REPO_URL="https://github.com/enclustra-bsp/xilinx-linux.git"
BR2_LINUX_KERNEL_CUSTOM_REPO_VERSION="v1.8.2"
BR2_LINUX_KERNEL_USE_CUSTOM_CONFIG=y
BR2_LINUX_KERNEL_CUSTOM_CONFIG_FILE="board/tsat/3500/common/linux.config"
BR2_LINUX_KERNEL_UIMAGE=y
BR2_LINUX_KERNEL_UIMAGE_LOADADDR="0x8000"
BR2_LINUX_KERNEL_DTS_SUPPORT=y
BR2_LINUX_KERNEL_CUSTOM_DTS_PATH="board/tsat/3500/common/linux.dts"
BR2_PACKAGE_BUSYBOX_SHOW_OTHERS=y
BR2_PACKAGE_ZSTD=y
BR2_PACKAGE_MTD=y
# BR2_PACKAGE_MTD_NANDDUMP is not set
# BR2_PACKAGE_MTD_NANDTEST is not set
# BR2_PACKAGE_MTD_NANDWRITE is not set
# BR2_PACKAGE_MTD_UBIATTACH is not set
# BR2_PACKAGE_MTD_UBICRC32 is not set
# BR2_PACKAGE_MTD_UBIDETACH is not set
# BR2_PACKAGE_MTD_UBIFORMAT is not set
# BR2_PACKAGE_MTD_UBIMKVOL is not set
# BR2_PACKAGE_MTD_UBINFO is not set
# BR2_PACKAGE_MTD_UBINIZE is not set
# BR2_PACKAGE_MTD_UBIRENAME is not set
# BR2_PACKAGE_MTD_UBIRMVOL is not set
# BR2_PACKAGE_MTD_UBIRSVOL is not set
# BR2_PACKAGE_MTD_UBIUPDATEVOL is not set
# BR2_PACKAGE_MTD_UBIBLOCK is not set
BR2_PACKAGE_MEMTESTER=y
BR2_PACKAGE_UBOOT_TOOLS=y
BR2_PACKAGE_LIBGPIOD_TOOLS=y
BR2_PACKAGE_LIBIIO=y
# BR2_PACKAGE_LIBIIO_XML_BACKEND is not set
# BR2_PACKAGE_LIBIIO_NETWORK_BACKEND is not set
# BR2_PACKAGE_LIBIIO_USB_BACKEND is not set
# BR2_PACKAGE_LIBIIO_SERIAL_BACKEND is not set
BR2_PACKAGE_LIBIIO_TESTS=y
BR2_PACKAGE_NGINX=y
# BR2_PACKAGE_NGINX_HTTP_SSI_MODULE is not set
# BR2_PACKAGE_NGINX_HTTP_AUTOINDEX_MODULE is not set
# BR2_PACKAGE_NGINX_HTTP_GEO_MODULE is not set
# BR2_PACKAGE_NGINX_HTTP_MAP_MODULE is not set
# BR2_PACKAGE_NGINX_HTTP_SPLIT_CLIENTS_MODULE is not set
# BR2_PACKAGE_NGINX_HTTP_REFERER_MODULE is not set
# BR2_PACKAGE_NGINX_HTTP_FASTCGI_MODULE is not set
# BR2_PACKAGE_NGINX_HTTP_UWSGI_MODULE is not set
# BR2_PACKAGE_NGINX_HTTP_SCGI_MODULE is not set
# BR2_PACKAGE_NGINX_HTTP_MEMCACHED_MODULE is not set
# BR2_PACKAGE_NGINX_HTTP_LIMIT_CONN_MODULE is not set
# BR2_PACKAGE_NGINX_HTTP_LIMIT_REQ_MODULE is not set
# BR2_PACKAGE_NGINX_HTTP_EMPTY_GIF_MODULE is not set
# BR2_PACKAGE_NGINX_HTTP_BROWSER_MODULE is not set
# BR2_PACKAGE_NGINX_HTTP_UPSTREAM_IP_HASH_MODULE is not set
# BR2_PACKAGE_NGINX_HTTP_UPSTREAM_LEAST_CONN_MODULE is not set
# BR2_PACKAGE_NGINX_HTTP_UPSTREAM_KEEPALIVE_MODULE is not set
BR2_PACKAGE_OPENSSH=y
BR2_PACKAGE_TCPDUMP=y
BR2_PACKAGE_SWUPDATE=y
BR2_PACKAGE_SWUPDATE_CONFIG="board/tsat/3500/common/swupdate.config"
# BR2_PACKAGE_SWUPDATE_INSTALL_WEBSITE is not set
BR2_PACKAGE_UTIL_LINUX=y
BR2_PACKAGE_UTIL_LINUX_LIBBLKID=y
BR2_PACKAGE_UTIL_LINUX_LIBUUID=y
BR2_TARGET_ROOTFS_EXT2=y
BR2_TARGET_ROOTFS_EXT2_4=y
BR2_TARGET_ROOTFS_EXT2_LABEL="ROOTFS"
BR2_TARGET_ROOTFS_EXT2_SIZE="128M"
# BR2_TARGET_ROOTFS_TAR is not set
BR2_TARGET_UBOOT=y
BR2_TARGET_UBOOT_BUILD_SYSTEM_KCONFIG=y
BR2_TARGET_UBOOT_CUSTOM_GIT=y
BR2_TARGET_UBOOT_CUSTOM_REPO_URL="https://github.com/enclustra-bsp/xilinx-uboot.git"
BR2_TARGET_UBOOT_CUSTOM_REPO_VERSION="v1.8.2"
BR2_TARGET_UBOOT_USE_CUSTOM_CONFIG=y
BR2_TARGET_UBOOT_CUSTOM_CONFIG_FILE="board/tsat/3500/mmc/uboot.config"
BR2_TARGET_UBOOT_NEEDS_DTC=y
# BR2_TARGET_UBOOT_FORMAT_BIN is not set
BR2_TARGET_UBOOT_FORMAT_ELF=y
BR2_TARGET_UBOOT_ENVIMAGE=y
BR2_TARGET_UBOOT_ENVIMAGE_SOURCE="board/tsat/3500/common/uboot/env.txt"
BR2_TARGET_UBOOT_ENVIMAGE_SIZE="0x80000"
BR2_TARGET_UBOOT_BOOT_SCRIPT=y
BR2_TARGET_UBOOT_BOOT_SCRIPT_SOURCE="board/tsat/3500/mmc/uboot/boot_script.txt"
BR2_TARGET_UBOOT_CUSTOM_DTS_PATH="board/tsat/3500/common/uboot.dts"
BR2_PACKAGE_HOST_CMAKE=y
BR2_PACKAGE_HOST_DOSFSTOOLS=y
BR2_PACKAGE_HOST_GENIMAGE=y
BR2_PACKAGE_HOST_MTOOLS=y
```

## package/adrf6755/Config.in
```kconfig
config BR2_PACKAGE_ADRF6755
	bool "adrf6755"
	depends on BR2_LINUX_KERNEL
	help
	  ADRF6755 tuner kernel module
```

## package/tsat/Config.in
```kconfig
source "package/tsat/adrf6755/Config.in"
source "package/tsat/terminal/Config.in"
source "package/tsat/tps65233/Config.in"
source "package/tsat/librohc/Config.in"
```

## package/tsat/Config.in.host
```kconfig
source "package/tsat/bootgen/Config.in.host"
source "package/tsat/mkswu/Config.in.host"
source "package/tsat/libykcs11/Config.in.host"
```

## package/tsat/bootgen/Config.in.host
```kconfig
config BR2_PACKAGE_HOST_BOOTGEN
	bool "bootgen"
	default y
	help
	  Xilinx boot image builder
```

## package/tsat/librohc/Config.in
```kconfig
config BR2_PACKAGE_LIBROHC
	bool "librohc"
	default y
	select BR2_PACKAGE_LIBPCAP
	select BR2_PACKAGE_CMOCKA
	help
	  ROHC library
```

## package/tsat/libykcs11/Config.in.host
```kconfig
config BR2_PACKAGE_HOST_LIBYKCS11
	bool "libykcs11"
	default y
	help
	  Host library needed to interface openssl PKCS11 engine with Yubikey smart card emulator

if BR2_PACKAGE_HOST_LIBYKCS11

config BR2_PACKAGE_HOST_LIBYKCS11_PCSCLITE_PKG_PATH
	string "Path to pkcs-lite pkg-config file"
	default "/usr/lib/x86_64-linux-gnu/pkgconfig"
	help
	  libykcs11 is linked with the host system's native libpcsclite
	  to be compatible with the native pcscd. The pkg-config (.pc)
	  file is provided by the package libpcsclite-dev.

endif
```

## package/tsat/mkbootimage/Config.in.host
```kconfig
config BR2_PACKAGE_HOST_MKBOOTIMAGE
	bool "mkbootimage"
	default y
	help
	  Antmicro's Zynq boot image builder
```

## package/tsat/mkswu/Config.in.host
```kconfig
config BR2_PACKAGE_HOST_MKSWU
	bool "mkswu"
	default y
	help
	  Scripts to generate swupdate upgrade packages
```

## package/tsat/terminal/Config.in
```kconfig
config BR2_PACKAGE_TERMINAL
	bool "terminal"
	default y
	select BR2_PACKAGE_BOOST
	select BR2_PACKAGE_BOOST_ATOMIC
	select BR2_PACKAGE_BOOST_CHRONO
	select BR2_PACKAGE_BOOST_DATE_TIME
	select BR2_PACKAGE_BOOST_FILESYSTEM
	select BR2_PACKAGE_BOOST_LOG
	select BR2_PACKAGE_BOOST_PROGRAM_OPTIONS
	select BR2_PACKAGE_BOOST_REGEX
	select BR2_PACKAGE_BOOST_SYSTEM
	select BR2_PACKAGE_BOOST_THREAD
	select BR2_PACKAGE_LIBNFTNL
	select BR2_PACKAGE_LIBNL
	select BR2_PACKAGE_LIBOPENSSL
	select BR2_PACKAGE_LIBGPIOD
	select BR2_PACKAGE_NFTABLES
	depends on BR2_PACKAGE_LIBIIO
	help
	  Main terminal executable
```

## package/tsat/tps65233/Config.in
```kconfig
config BR2_PACKAGE_TPS65233
	bool "tps65233"
	default y
	depends on BR2_LINUX_KERNEL
	help
	  TPS65233 LNB kernel module
```
